## tincan/Config.in
```kconfig
source "$BR2_EXTERNAL_TINCAN_PATH/package/python-sapphire-config/Config.in"
source "$BR2_EXTERNAL_TINCAN_PATH/package/python-datatransport/Config.in"
source "$BR2_EXTERNAL_TINCAN_PATH/package/ts7100-utils/Config.in"
source "$BR2_EXTERNAL_TINCAN_PATH/package/tssupervisorupdate/Config.in"
source "$BR2_EXTERNAL_TINCAN_PATH/package/tincan-network/Config.in"
source "$BR2_EXTERNAL_TINCAN_PATH/package/zramswap/Config.in"
```

## tincan/configs/conga-tincan-ts7250v3-v1_defconfig
```kconfig
BR2_arm=y
BR2_cortex_a7=y
BR2_ARM_FPU_NEON_VFPV4=y
BR2_KERNEL_HEADERS_5_10=y
BR2_PACKAGE_GLIBC_UTILS=y
BR2_TOOLCHAIN_BUILDROOT_CXX=y
BR2_CCACHE=y
BR2_GLOBAL_PATCH_DIR="$(BR2_EXTERNAL_TINCAN_PATH)/board/common/patches"
BR2_TIME_BITS_64=y
BR2_TARGET_GENERIC_HOSTNAME="tincan.INTERNAL"
BR2_TARGET_GENERIC_ISSUE="CONGA Tincan Station"
BR2_INIT_SYSTEMD=y
BR2_ROOTFS_DEVICE_TABLE="$(BR2_EXTERNAL_TINCAN_PATH)/board/common/device_table.txt"
BR2_TARGET_GENERIC_ROOT_PASSWD="$$6$$rounds=10000$$congatec$$D2EN04xo23mNwNNe4S9g5CONZESASF3cbo40L9RdWb/SRGz03jyqjMpF1JRbEE0Wm9gQ4HIPz41BR6ClOiXPX0"
BR2_SYSTEM_BIN_SH_BASH=y
BR2_TARGET_GENERIC_GETTY_PORT="ttymxc0"
BR2_SYSTEM_DEFAULT_PATH="/bin:/sbin:/usr/bin:/usr/sbin:/usr/local/bin"
BR2_ENABLE_LOCALE_WHITELIST="C en_US en_US.utf8"
BR2_GENERATE_LOCALE="C en_US"
BR2_ROOTFS_USERS_TABLES="$(BR2_EXTERNAL_TINCAN_PATH)/board/common/users_table.txt"
BR2_ROOTFS_OVERLAY="$(BR2_EXTERNAL_TINCAN_PATH)/board/common/overlay $(BR2_EXTERNAL_TINCAN_PATH)/board/conga-tincan-ts7250v3-v1/overlay"
BR2_ROOTFS_POST_BUILD_SCRIPT="$(BR2_EXTERNAL_TINCAN_PATH)/common/copy-bootscr-post_build.sh $(BR2_EXTERNAL_TINCAN_PATH)/common/copy-secrets-post_build.sh"
BR2_ROOTFS_POST_IMAGE_SCRIPT="$(BR2_EXTERNAL_TINCAN_PATH)/board/common/post-image.sh"
BR2_ROOTFS_POST_SCRIPT_ARGS="secretsdir=$(BR2_EXTERNAL_TINCAN_PATH)/../secrets"
BR2_LINUX_KERNEL=y
BR2_LINUX_KERNEL_CUSTOM_TARBALL=y
BR2_LINUX_KERNEL_CUSTOM_TARBALL_LOCATION="$(call github,embeddedTS,linux-lts,v5.10.202.1-ts)/linux-v5.10.202.1-ts.tar.gz"
BR2_LINUX_KERNEL_USE_CUSTOM_CONFIG=y
BR2_LINUX_KERNEL_CUSTOM_CONFIG_FILE="$(BR2_EXTERNAL_TINCAN_PATH)/board/conga-tincan-ts7250v3-v1/kernel.config"
BR2_LINUX_KERNEL_DTS_SUPPORT=y
BR2_LINUX_KERNEL_INTREE_DTS_NAME="imx6ul-ts7250v3 imx6ul-ts7250v3-reva"
BR2_LINUX_KERNEL_INSTALL_TARGET=y
BR2_PACKAGE_BUSYBOX_CONFIG="$(BR2_EXTERNAL_TINCAN_PATH)/board/common/busybox.config"
BR2_PACKAGE_BUSYBOX_WATCHDOG=y
BR2_PACKAGE_BUSYBOX_WATCHDOG_PERIOD="30"
BR2_PACKAGE_GZIP=y
BR2_PACKAGE_UNRAR=y
BR2_PACKAGE_ZIP=y
BR2_PACKAGE_LSOF=y
BR2_PACKAGE_STRACE=y
BR2_PACKAGE_GAWK=y
BR2_PACKAGE_GIT=y
BR2_PACKAGE_JQ=y
BR2_PACKAGE_SED=y
BR2_PACKAGE_E2FSPROGS=y
BR2_PACKAGE_E2FSPROGS_RESIZE2FS=y
BR2_PACKAGE_EXFAT=y
BR2_PACKAGE_EXFAT_UTILS=y
BR2_PACKAGE_EXFATPROGS=y
BR2_PACKAGE_MMC_UTILS=y
BR2_PACKAGE_WILC3000_FIRMWARE=y
BR2_PACKAGE_GPSD=y
BR2_PACKAGE_GPSD_DEVICES="/dev/gps"
BR2_PACKAGE_GPSD_UBX=y
BR2_PACKAGE_GPSD_PYTHON=y
BR2_PACKAGE_I2C_TOOLS=y
BR2_PACKAGE_LM_SENSORS=y
BR2_PACKAGE_LSHW=y
BR2_PACKAGE_MEMTESTER=y
BR2_PACKAGE_MINICOM=y
BR2_PACKAGE_NANOCOM=y
BR2_PACKAGE_PARTED=y
BR2_PACKAGE_PCIUTILS=y
BR2_PACKAGE_PICOCOM=y
BR2_PACKAGE_RNG_TOOLS=y
BR2_PACKAGE_RTC_TOOLS=y
BR2_PACKAGE_SETSERIAL=y
BR2_PACKAGE_SPI_TOOLS=y
BR2_PACKAGE_STATSERIAL=y
BR2_PACKAGE_UBOOT_TOOLS=y
BR2_PACKAGE_UBOOT_TOOLS_MKIMAGE=y
BR2_PACKAGE_UBOOT_TOOLS_MKENVIMAGE=y
BR2_PACKAGE_UHUBCTL=y
BR2_PACKAGE_USBUTILS=y
BR2_PACKAGE_WILC_DRIVER=y
BR2_PACKAGE_WILC_DRIVER_SPI=y
BR2_PACKAGE_PYTHON3_2TO3=y
BR2_PACKAGE_PYTHON3_BERKELEYDB=y
BR2_PACKAGE_PYTHON3_BZIP2=y
BR2_PACKAGE_PYTHON3_CURSES=y
BR2_PACKAGE_PYTHON3_DECIMAL=y
BR2_PACKAGE_PYTHON3_READLINE=y
BR2_PACKAGE_PYTHON3_SQLITE=y
BR2_PACKAGE_PYTHON3_XZ=y
BR2_PACKAGE_PYTHON_CLICK=y
BR2_PACKAGE_PYTHON_MODBUS_TK=y
BR2_PACKAGE_PYTHON_PYTZ=y
BR2_PACKAGE_PYTHON_REQUESTS=y
BR2_PACKAGE_CA_CERTIFICATES=y
BR2_PACKAGE_LIBGCRYPT=y
BR2_PACKAGE_POSTGRESQL=y
BR2_PACKAGE_POSTGRESQL_FULL=y
BR2_PACKAGE_LIBGPIOD_TOOLS=y
BR2_PACKAGE_LIBUSB_COMPAT=y
BR2_PACKAGE_LIBCURL=y
BR2_PACKAGE_LIBCURL_CURL=y
BR2_PACKAGE_LIBCURL_VERBOSE=y
BR2_PACKAGE_NCURSES_WCHAR=y
BR2_PACKAGE_NCURSES_TARGET_PROGS=y
BR2_PACKAGE_NCURSES_ADDITIONAL_TERMINFO="v/vt100"
BR2_PACKAGE_ARP_SCAN=y
BR2_PACKAGE_CHRONY=y
BR2_PACKAGE_DNSMASQ=y
BR2_PACKAGE_IFTOP=y
BR2_PACKAGE_IPTABLES=y
BR2_PACKAGE_NETWORK_MANAGER=y
BR2_PACKAGE_NETWORK_MANAGER_TUI=y
BR2_PACKAGE_NETWORK_MANAGER_CLI=y
BR2_PACKAGE_NETWORK_MANAGER_MODEM_MANAGER=y
BR2_PACKAGE_NETWORK_MANAGER_PPPD=y
BR2_PACKAGE_OPENRESOLV=y
BR2_PACKAGE_RSYNC=y
BR2_PACKAGE_WGET=y
BR2_PACKAGE_WIREGUARD_TOOLS=y
BR2_PACKAGE_WIRELESS_REGDB=y
BR2_PACKAGE_WIRELESS_TOOLS=y
BR2_PACKAGE_WIRELESS_TOOLS_LIB=y
BR2_PACKAGE_WPA_SUPPLICANT=y
BR2_PACKAGE_WPA_SUPPLICANT_AP_SUPPORT=y
BR2_PACKAGE_WPA_SUPPLICANT_WIFI_DISPLAY=y
BR2_PACKAGE_WPA_SUPPLICANT_MESH_NETWORKING=y
BR2_PACKAGE_WPA_SUPPLICANT_AUTOSCAN=y
BR2_PACKAGE_WPA_SUPPLICANT_HOTSPOT=y
BR2_PACKAGE_WPA_SUPPLICANT_DEBUG_SYSLOG=y
BR2_PACKAGE_WPA_SUPPLICANT_WPS=y
BR2_PACKAGE_WPA_SUPPLICANT_WPA3=y
BR2_PACKAGE_WPA_SUPPLICANT_CLI=y
BR2_PACKAGE_WPA_SUPPLICANT_WPA_CLIENT_SO=y
BR2_PACKAGE_WPA_SUPPLICANT_PASSPHRASE=y
BR2_PACKAGE_WPA_SUPPLICANT_DBUS=y
BR2_PACKAGE_WPA_SUPPLICANT_DBUS_INTROSPECTION=y
BR2_PACKAGE_AT=y
BR2_PACKAGE_BASH_COMPLETION=y
BR2_PACKAGE_FILE=y
BR2_PACKAGE_LOGROTATE=y
BR2_PACKAGE_SUDO=y
BR2_PACKAGE_TMUX=y
BR2_PACKAGE_ATTR=y
BR2_PACKAGE_COREUTILS=y
BR2_PACKAGE_DCRON=y
BR2_PACKAGE_HTOP=y
BR2_PACKAGE_PROCPS_NG=y
BR2_PACKAGE_RSYSLOG=y
BR2_PACKAGE_SUPERVISOR=y
BR2_PACKAGE_SYSTEMD_ANALYZE=y
BR2_PACKAGE_SYSTEMD_RANDOMSEED=y
BR2_PACKAGE_SYSTEMD_REPART=y
BR2_PACKAGE_TAR=y
BR2_PACKAGE_UTIL_LINUX_BINARIES=y
BR2_PACKAGE_UTIL_LINUX_HWCLOCK=y
BR2_PACKAGE_UTIL_LINUX_PARTX=y
BR2_PACKAGE_UTIL_LINUX_VIPW=y
BR2_PACKAGE_UTIL_LINUX_ZRAMCTL=y
BR2_PACKAGE_LESS=y
BR2_PACKAGE_NANO=y
BR2_PACKAGE_VIM=y
BR2_TARGET_ROOTFS_TAR_XZ=y
BR2_PACKAGE_HOST_KMOD_XZ=y
BR2_PACKAGE_HOST_PKGCONF=y
BR2_PACKAGE_HOST_UBOOT_TOOLS=y
BR2_PACKAGE_HOST_UBOOT_TOOLS_BOOT_SCRIPT=y
BR2_PACKAGE_HOST_UBOOT_TOOLS_BOOT_SCRIPT_SOURCE="$(BR2_EXTERNAL_TINCAN_PATH)/board/conga-tincan-ts7250v3-v1/boot.source"
BR2_PACKAGE_PYTHON_DATATRANSPORT=y
BR2_PACKAGE_TS7100_UTILS=y
BR2_PACKAGE_TSSUPERVISORUPDATE=y
BR2_PACKAGE_TINCAN_NETWORK=y
BR2_PACKAGE_TINCAN_NETWORK_GROUP="conga"
BR2_PACKAGE_TINCAN_NETWORK_SERVER="https://conga.datatransport.org/tincan/v1"
BR2_PACKAGE_ZRAMSWAP=y
```

## tincan/package/tincan-network/Config.in
```kconfig
config BR2_PACKAGE_TINCAN_NETWORK
	bool "tincan-network"
    select BR2_PACKAGE_PYTHON3
    select BR2_PACKAGE_OPENSSH
	help
	    Tincan network support 

	    Includes tools to create, manage and monitor Tincan SSH tunnels.

		https://github.com/valentic/tincan-network

if BR2_PACKAGE_TINCAN_NETWORK

config BR2_PACKAGE_TINCAN_NETWORK_GROUP
    string "Group name"
    default "tincan"
    help
        Name of the group to use for the tincan network

config BR2_PACKAGE_TINCAN_NETWORK_SERVER
    string "Server URL"
    default "https://someserver/tincan/v1"
    help
        URL of the server to use for the tincan network

        https://someserver/tincan/v1

endif
```

## tincan/package/zramswap/Config.in
```kconfig
config BR2_PACKAGE_ZRAMSWAP
	bool "zramswap"
	help
	    Sets up zram based swap devices on boot 

	    https://aur.archlinux.org/packages/zramswap	
```
